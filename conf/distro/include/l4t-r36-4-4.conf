## conf/machine/jetson-orin-nano-devkit-wendyos.conf
```bitbake
# jetson-orin-nano-devkit-wendyos.conf

# include upstream base if available
require conf/machine/jetson-orin-nano-devkit.conf

# AB upgrades & bootloader choices (board-specific)
UBOOT_EXTLINUX = "1"
USE_REDUNDANT_FLASH_LAYOUT_DEFAULT = "1"

MENDER_FEATURES_DISABLE:append = " mender-uboot"
MENDER_EFI_LOADER = ""

# UEFI Capsule Update Configuration
# Disable Secure Boot for development/testing (no signing keys configured)
# When "false": No key enrollment, Secure Boot disabled, unsigned capsules accepted
# Set to "true" for production after implementing proper signing infrastructure
TEGRA_UEFI_USE_SIGNED_FILES = "false"

# Storage geometry (board-specific)
MENDER_STORAGE_TOTAL_SIZE_MB = "16384"
MENDER_STORAGE_DEVICE_BASE = "/dev/mmcblk0p"
MENDER_BOOT_PART = "${MENDER_STORAGE_DEVICE_BASE}11"
MENDER_ROOTFS_PART_A = "${MENDER_STORAGE_DEVICE_BASE}1"
MENDER_ROOTFS_PART_B = "${MENDER_STORAGE_DEVICE_BASE}2"

# Use mender_data partition (added by tegra-storage-layout-base bbappend after APP_b)
# instead of UDA (p15) which is positioned before APP and cannot expand.
MENDER_DATA_PART_NUMBER = "17"
MENDER_DATA_PART = "${MENDER_STORAGE_DEVICE_BASE}${MENDER_DATA_PART_NUMBER}"

# Initial size - will auto-expand on first boot
MENDER_DATA_PART_SIZE_MB = "400"

# BUP (Bootloader Update Payload) must not reference data partition images
TEGRA_BUPGEN_STRIP_IMG_NAMES:append = " config-partition.fat32.img"

# Jetson image formats that are machine/BSP oriented:
IMAGE_FSTYPES:tegra = "tegraflash mender dataimg"
IMAGE_FSTYPES:pn-tegra-minimal-initramfs:tegra = "${INITRAMFS_FSTYPES}"
IMAGE_FSTYPES:pn-tegra-initrd-flash-initramfs:tegra = "${TEGRA_INITRD_FLASH_INITRAMFS_FSTYPES}"

# If you really need it, board param (but consider removing if unused):
EMMC_SIZE = "0"

# Stable board identity written to /etc/wendyos/device-type
WENDYOS_BOARD_ID = "jetson-orin-nano-sd"
```

## conf/machine/qemuarm64-wendyos.conf
```bitbake
#@TYPE: Machine
#@NAME: QEMU ARM64 WendyOS
#@DESCRIPTION: Machine configuration for running WendyOS on QEMU ARMv8

# Inherit base QEMU ARM64 configuration from poky
require conf/machine/qemuarm64.conf

# Note: MACHINEOVERRIDES inherited from qemu.inc includes "qemuall"
# Do NOT add "qemu:" here as it conflicts with the qemu recipe package name

# Image formats - no Tegra-specific formats
# Remove tegraflash, mender (for now), dataimg
# Keep ext4 for QEMU rootfs, tar.bz2 for SDK
IMAGE_FSTYPES = "ext4 tar.bz2"

# Explicitly remove Tegra-specific image types added by meta-mender-tegra
# tegra-mender-setup.bbclass (global class) unconditionally adds these
IMAGE_FSTYPES:remove = "tegraflash dataimg"
IMAGE_CLASSES:remove = "image_types_mender_tegra"

# Remove UEFI image types added by mender-full class (not needed for QEMU)
IMAGE_FSTYPES:remove = "uefiimg uefiimg.bmap uefiimg.bz2"

# Clear boot files for QEMU (no separate boot partition needed)
# This prevents "MENDER_BOOT_PART_SIZE_MB is set to zero" warning
IMAGE_BOOT_FILES = ""

# WendyOS feature flags for QEMU
# No USB gadget in QEMU (we'll use virtio-net renamed to usb0)
WENDYOS_USB_GADGET ?= "0"

# Mender configuration for QEMU
# meta-mender-tegra sets EXTRADEPS:tegra with Tegra-specific packages
# For QEMU, we need to explicitly set it to empty to avoid unresolved dependencies
EXTRADEPS = ""

# Mender is disabled for QEMU builds (see wendyos-image.bb)
# QEMU uses simple single-partition ext4 layout without Mender A/B partitions
# If you need to test Mender in QEMU, uncomment the following and modify wendyos-image.bb:
# MENDER_STORAGE_TOTAL_SIZE_MB = "32768"
# MENDER_DATA_PART_NUMBER = "3"
# MENDER_ROOTFS_PART_A_NUMBER = "1"
# MENDER_ROOTFS_PART_B_NUMBER = "2"

# No DeepStream (requires NVIDIA GPU)
WENDYOS_DEEPSTREAM ?= "0"

# No UEFI capsule updates in QEMU
WENDYOS_UPDATE_BOOTLOADER ?= "0"

# No EFI debug mode needed
WENDYOS_EFI_DEBUG ?= "0"

# QEMU-specific settings override
# Use 4GB RAM (matching typical Jetson Orin Nano config)
QB_MEM = "-m 4096"

# Use multiple CPUs for better performance
QB_SMP = "-smp 4"

# Network device configuration
# Using virtio-net-pci (will be renamed to usb0 via udev)
QB_TAP_OPT = "-netdev tap,id=net0,ifname=@TAP@,script=no,downscript=no"
QB_NETWORK_DEVICE = "-device virtio-net-pci,netdev=net0,mac=@MAC@"

# Kernel image type
KERNEL_IMAGETYPE = "Image"

# Serial console
SERIAL_CONSOLES = "115200;ttyAMA0"

# Machine features
MACHINE_FEATURES = "alsa bluetooth usbgadget usbhost vfat ext2 screen"

# Stable board identity written to /etc/wendyos/device-type
WENDYOS_BOARD_ID = "qemu-arm64"
```

## conf/machine/raspberrypi3-64-wendyos.conf
```bitbake
MACHINEOVERRIDES =. "rpi:raspberrypi3-64:"
require conf/machine/raspberrypi3-64.conf

# WIC GPT image — no Mender, no tegraflash
IMAGE_FSTYPES = "wic wic.bmap"
IMAGE_FSTYPES:remove = "tegraflash dataimg mender uefiimg uefiimg.bmap uefiimg.bz2"
WKS_FILE = "rpi-partuuid.wks"
WKS_FILE_DEPENDS += "gptfdisk"
LICENSE_FLAGS_ACCEPTED += "synaptics-killswitch"

# No Mender, no UEFI capsule updates
WENDYOS_UPDATE_BOOTLOADER ?= "0"
WENDYOS_EFI_DEBUG ?= "0"
WENDYOS_DEEPSTREAM ?= "0"
# Default persist=off; single partition, no /data
WENDYOS_PERSIST_JOURNAL_LOGS ?= "0"
# RPi3 B/B+ cannot do USB gadget (LAN9514 hub blocks DWC2 peripheral mode)
# RPi3 A+ technically can, but requires non-standard cable + external power
WENDYOS_USB_GADGET ?= "0"
# No usb0 interface on RPi3 — allow mDNS on all interfaces (WiFi/Ethernet)
WENDYOS_MDNS_INTERFACES ?= ""
WENDYOS_DEBUG ?= "0"

# RPi3 boot config (consumed by rpi-config_%.bbappend)
# No dtparam=pciex1 — RPi3 has no PCIe.
# No UART overlay — Bluetooth stays on PL011 (ttyAMA0), serial console uses the
# mini UART (ttyS0) on GPIO 14/15. Mini UART baud rate can drift under heavy
# CPU load (its clock is derived from the VPU clock), so serial output may
# occasionally garble during boot or under sustained load. Acceptable trade-off
# for keeping onboard Bluetooth available.
ENABLE_UART = "1"
ENABLE_DWC2_PERIPHERAL = "${@oe.utils.ifelse(d.getVar('WENDYOS_USB_GADGET') == '1', '1', '0')}"
DISABLE_RPI_BOOT_LOGO = "1"
DISABLE_SPLASH = "1"
DISABLE_OVERSCAN = "1"

# Mini UART on GPIO 14/15 (upstream default for RPi3)
SERIAL_CONSOLES = "115200;ttyS0"
SERIAL_CONSOLES_CHECK = ""
MACHINE_FEATURES:append = " wifi bluetooth"
EXTRADEPS = ""

# Stable board identity written to /etc/wendyos/device-type
WENDYOS_BOARD_ID = "rpi3-sd"
```

## conf/machine/raspberrypi4-64-wendyos.conf
```bitbake
MACHINEOVERRIDES =. "rpi:raspberrypi4-64:"
require conf/machine/raspberrypi4-64.conf

# WIC GPT image — no Mender, no tegraflash
IMAGE_FSTYPES = "wic wic.bmap"
IMAGE_FSTYPES:remove = "tegraflash dataimg mender uefiimg uefiimg.bmap uefiimg.bz2"
WKS_FILE = "rpi-partuuid.wks"
WKS_FILE_DEPENDS += "gptfdisk"
LICENSE_FLAGS_ACCEPTED += "synaptics-killswitch"

# No Mender, no UEFI capsule updates
WENDYOS_UPDATE_BOOTLOADER ?= "0"
WENDYOS_EFI_DEBUG ?= "0"
WENDYOS_DEEPSTREAM ?= "0"
# Default persist=off; single partition, no /data
WENDYOS_PERSIST_JOURNAL_LOGS ?= "0"
# RPi4 has an OTG-capable USB-C port — enable gadget by default
WENDYOS_USB_GADGET ?= "1"
# Advertise mDNS on both USB gadget and WiFi interfaces
WENDYOS_MDNS_INTERFACES ?= "usb0 wlan0"
WENDYOS_DEBUG ?= "0"
WENDYOS_CONTAINER_RUNTIME ?= "1"

# RPi4 boot config (consumed by rpi-config_%.bbappend)
# No dtparam=pciex1 — RPi4 has no user-facing PCIe lane.
# No UART overlay — Bluetooth stays on PL011 (ttyAMA0), serial console uses the
# mini UART (ttyS0) on GPIO 14/15. Mini UART baud rate can drift under heavy
# CPU load (its clock is derived from the VPU clock), so serial output may
# occasionally garble during boot or under sustained load. Acceptable trade-off
# for keeping onboard Bluetooth available.
ENABLE_UART = "1"
ENABLE_DWC2_PERIPHERAL = "${@oe.utils.ifelse(d.getVar('WENDYOS_USB_GADGET') == '1', '1', '0')}"
DISABLE_RPI_BOOT_LOGO = "1"
DISABLE_SPLASH = "1"
DISABLE_OVERSCAN = "1"

# Mini UART on GPIO 14/15 (upstream default for RPi4)
SERIAL_CONSOLES = "115200;ttyS0"
SERIAL_CONSOLES_CHECK = ""
MACHINE_FEATURES:append = " wifi bluetooth usbgadget"
EXTRADEPS = ""

# Stable board identity written to /etc/wendyos/device-type
WENDYOS_BOARD_ID = "rpi4-sd"
```

## conf/machine/raspberrypi5-nvme-wendyos.conf
```bitbake
MACHINEOVERRIDES =. "rpi:raspberrypi5-nvme:raspberrypi5:"
require conf/machine/raspberrypi5-wendyos.conf

# NVMe WKS layout (SD card base uses rpi-partuuid.wks)
WKS_FILE = "rpi-nvme-partuuid.wks"

# dtparam=pciex1 is now inherited from raspberrypi5-wendyos.conf (set there so
# the SD image can also access the NVMe for SSH-based flashing workflows).
# Uncomment to override independently if the SD and NVMe configs need to diverge.
#RPI_EXTRA_CONFIG = "dtparam=pciex1\n"

# Stable board identity written to /etc/wendyos/device-type
# (overrides the rpi5-sd value set in raspberrypi5-wendyos.conf above)
WENDYOS_BOARD_ID = "rpi5-nvme"
```

## conf/machine/raspberrypi5-wendyos.conf
```bitbake
MACHINEOVERRIDES =. "rpi:raspberrypi5:"
require conf/machine/raspberrypi5.conf

# WIC GPT image — no Mender, no tegraflash
IMAGE_FSTYPES = "wic wic.bmap"
IMAGE_FSTYPES:remove = "tegraflash dataimg mender uefiimg uefiimg.bmap uefiimg.bz2"
WKS_FILE = "rpi-partuuid.wks"
WKS_FILE_DEPENDS += "gptfdisk"
LICENSE_FLAGS_ACCEPTED += "synaptics-killswitch"

# No Mender, no UEFI capsule updates
WENDYOS_UPDATE_BOOTLOADER ?= "0"
WENDYOS_EFI_DEBUG ?= "0"
WENDYOS_DEEPSTREAM ?= "0"
# Default persist=off; single partition, no /data
WENDYOS_PERSIST_JOURNAL_LOGS ?= "0"
WENDYOS_USB_GADGET ?= "1"
# Advertise mDNS on both USB gadget and WiFi interfaces
WENDYOS_MDNS_INTERFACES ?= ""
WENDYOS_DEBUG ?= "0"

# RPi5 boot config (consumed by rpi-config_%.bbappend)
# Enable PCIe x1 lane in the kernel device tree.
# Required for the kernel to access the NVMe drive (e.g. when booting from SD and
# flashing the NVMe over SSH, or for any data-only NVMe use from the SD image).
RPI_EXTRA_CONFIG = "dtparam=pciex1\n"
ENABLE_UART = "1"
ENABLE_DWC2_PERIPHERAL = "${@oe.utils.ifelse(d.getVar('WENDYOS_USB_GADGET') == '1', '1', '0')}"
DISABLE_RPI_BOOT_LOGO = "1"
DISABLE_SPLASH = "1"
DISABLE_OVERSCAN = "1"

SERIAL_CONSOLES = "115200;ttyAMA0"
SERIAL_CONSOLES_CHECK = ""
MACHINE_FEATURES:append = " wifi bluetooth usbgadget"
EXTRADEPS = ""

# Stable board identity written to /etc/wendyos/device-type
WENDYOS_BOARD_ID = "rpi5-sd"
```

## meta-qemu-extensions/conf/layer.conf
```bitbake
BBPATH:prepend := "${LAYERDIR}:"

BBFILES += " \
    ${LAYERDIR}/recipes-*/*/*.bb \
    ${LAYERDIR}/recipes-*/*/*.bbappend \
    "

BBFILE_COLLECTIONS += "wendyos-qemu"
BBFILE_PATTERN_wendyos-qemu := "^${LAYERDIR}/"
BBFILE_PRIORITY_wendyos-qemu = "51"

LAYERSERIES_COMPAT_wendyos-qemu = "scarthgap"
LAYERVERSION_wendyos-qemu = "1"
LAYERDEPENDS_wendyos-qemu = "core wendyos"
```

## meta-rpi-extensions/conf/layer.conf
```bitbake
BBPATH:prepend := "${LAYERDIR}:"

BBFILES += " \
    ${LAYERDIR}/recipes-*/*/*.bb \
    ${LAYERDIR}/recipes-*/*/*.bbappend \
    "

BBFILE_COLLECTIONS += "wendyos-rpi"
BBFILE_PATTERN_wendyos-rpi := "^${LAYERDIR}/"
BBFILE_PRIORITY_wendyos-rpi = "51"

LAYERSERIES_COMPAT_wendyos-rpi = "scarthgap"
LAYERVERSION_wendyos-rpi = "1"
LAYERDEPENDS_wendyos-rpi = "core wendyos"
```

## meta-tegra-extensions/conf/layer.conf
```bitbake
BBPATH:prepend := "${LAYERDIR}:"

BBFILES += " \
    ${LAYERDIR}/recipes-*/*/*.bb \
    ${LAYERDIR}/recipes-*/*/*.bbappend \
    "

BBFILE_COLLECTIONS += "wendyos-tegra"
BBFILE_PATTERN_wendyos-tegra := "^${LAYERDIR}/"
BBFILE_PRIORITY_wendyos-tegra = "51"

LAYERSERIES_COMPAT_wendyos-tegra = "scarthgap"
LAYERVERSION_wendyos-tegra = "1"
LAYERDEPENDS_wendyos-tegra = "core wendyos"
```
