## conf/layer.conf
```bitbake
# Make the layer visible to bitbake
BBPATH:prepend := "${LAYERDIR}:"

# Where to find recipes in this layer
BBFILES += " \
    ${LAYERDIR}/recipes-*/*/*.bb \
    ${LAYERDIR}/recipes-*/*/*.bbappend \
    "

# Register this layer
BBFILE_COLLECTIONS += "wendyos"
BBFILE_PATTERN_wendyos := "^${LAYERDIR}/"
BBFILE_PRIORITY_wendyos = "50"

# Layer compatibility (set to your Yocto release)
# Pick ONE or more that actually match your base (poky/meta, meta-tegra, etc.)
LAYERSERIES_COMPAT_wendyos = "whinlatter"
LAYERVERSION_wendyos = "1"

# Dependencies on other layers (at minimum you depend on 'core')
LAYERDEPENDS_wendyos = "core"

# This is used by the tegra-distro-sanity bbclass
# to identify the distro layer directory during
# bblayers checks.
TD_DISTRO_LAYERDIR = "${LAYERDIR}"
```

## conf/machine/jetson-agx-orin-devkit-emmc-wendyos.conf
```bitbake
# jetson-agx-orin-devkit-emmc-wendyos.conf
# eMMC boot configuration for Jetson AGX Orin DevKit (P3701-0005, 64GB module).
#
# This variant boots and writes WendyOS to the onboard 64GB eMMC instead of
# an external NVMe SSD. Flashing this image WILL OVERWRITE the factory NVIDIA
# JetPack image that ships on the eMMC of a new DevKit.

MACHINEOVERRIDES =. "jetson-agx-orin-devkit:"

# Inherit from upstream 64GB AGX Orin config (P3701-0005, SKU 0005)
# This sets TEGRA_BOARDSKU, KERNEL_DEVICETREE, BPMP DTB, PMIC, and SDRAM configs
# for the 64GB module variant
require conf/machine/p3737-0000-p3701-0005.conf

# Use NVIDIA prebuilt UEFI firmware for AGX Orin.
# Source-built edk2-firmware-tegra causes a boot loop on this platform.
# See docs/agx-orin-edk2-boot-loop.md for symptom details, pinned versions
# at the time the workaround was required, and the re-test checklist.
# (The same SoC and firmware path are used regardless of NVMe vs eMMC boot.)
PREFERRED_PROVIDER_virtual/bootloader = "tegra-uefi-prebuilt"

# AB upgrades & bootloader choices (board-specific)
UBOOT_EXTLINUX = "1"
USE_REDUNDANT_FLASH_LAYOUT_DEFAULT = "1"

MENDER_FEATURES_DISABLE:append = " mender-uboot"
MENDER_EFI_LOADER = ""

# UEFI Capsule Update Configuration
# Disable Secure Boot for development/testing (no signing keys configured)
# When "false": No key enrollment, Secure Boot disabled, unsigned capsules accepted
# Set to "true" for production after implementing proper signing infrastructure
TEGRA_UEFI_USE_SIGNED_FILES = "false"

# eMMC storage geometry (board-specific)
# Hard `=` (P3701-0005 module ships only with 64GB eMMC; no other valid size).
# WENDYOS_FLASH_IMAGE_SIZE = "64GB" yields MENDER_STORAGE_TOTAL_SIZE_MB = 51000
# (~49.8 GiB). The 64GB eMMC has ~59.28 GiB usable after vendor reserve, so the
# A/B layout fits with ~9 GiB headroom for the config + mender_data partitions.
WENDYOS_FLASH_IMAGE_SIZE = "64GB"
MENDER_STORAGE_DEVICE_BASE = "/dev/mmcblk0p"
MENDER_BOOT_PART = "${MENDER_STORAGE_DEVICE_BASE}11"
MENDER_ROOTFS_PART_A = "${MENDER_STORAGE_DEVICE_BASE}1"
MENDER_ROOTFS_PART_B = "${MENDER_STORAGE_DEVICE_BASE}2"

# IMPORTANT: Use partition 17 for Mender data, NOT partition 15 (UDA)
# UDA (p15) is reserved by NVIDIA and positioned before rootfs partitions,
# preventing expansion. Partition 17 (mender_data, renamed from permanet_user_storage)
# is positioned AFTER APP_b and can expand to fill remaining disk space.
# tegra_partition_config.bbclass (lines 310-319) iterates over ['sdcard',
# 'sdmmc_user'] device types in the template XML, so the eMMC layout is
# normalised to the same on-disk GPT (config p16 + mender_data p17) as NVMe.
MENDER_DATA_PART_NUMBER = "17"
MENDER_DATA_PART = "${MENDER_STORAGE_DEVICE_BASE}${MENDER_DATA_PART_NUMBER}"

# Initial size - will auto-expand on first boot via mender-grow-data.service
MENDER_DATA_PART_SIZE_MB = "512"

# BUP (Bootloader Update Payload) must not reference data partition images.
# For sdmmc_user-based machines the config and mender_data partitions live in
# the same XML that BUP processes, so without this strip BUP fails at payload
# generation looking for config-partition.fat32.img. Same pattern as the
# Nano-SD variant; not needed on NVMe variants where these partitions are in
# the EXTERNAL XML which BUP does not read.
TEGRA_BUPGEN_STRIP_IMG_NAMES:append = " config-partition.fat32.img"

# eMMC boot device configuration (mmcblk0 = onboard eMMC on AGX; mmcblk1 = SD slot).
TNSPEC_BOOTDEV = "mmcblk0p1"

# Partition layout: QSPI for the boot chain + eMMC user area for rootfs A/B.
# This matches agx-orin.inc's upstream default and contrasts with the NVMe
# variant which uses flash_t234_qspi.xml + flash_l4t_t234_nvme.xml.
#
# Do NOT set PARTITION_LAYOUT_TEMPLATE_DEFAULT_SUPPORTS_REDUNDANT here. The
# bare flash_t234_qspi_sdmmc.xml in the BSP tarball has only APP (no APP_b),
# so we must let tegra-common.inc:140 auto-substitute to the
# flash_t234_qspi_sdmmc_rootfs_ab.xml variant which has both APP and APP_b.
# The WendyOS bbclass (tegra_partition_config.bbclass:312) then adds config
# (p16) and mender_data (p17) on top of the A/B template.
PARTITION_LAYOUT_TEMPLATE_DEFAULT = "flash_t234_qspi_sdmmc.xml"

# Suppress NVMe external XML processing for this internal-eMMC machine.
# tegra234.inc inherits PARTITION_LAYOUT_EXTERNAL_DEFAULT = "flash_l4t_t234_nvme.xml";
# the empty override stops tegra-storage-layout from generating an unused
# external-flash.xml and prevents accidental "doexternal.sh against NVMe"
# usage with an eMMC-targeted image.
PARTITION_LAYOUT_EXTERNAL_DEFAULT = ""

# Jetson image formats that are machine/BSP oriented:
IMAGE_FSTYPES:tegra = "tegraflash mender dataimg"
IMAGE_FSTYPES:pn-tegra-minimal-initramfs:tegra = "${INITRAMFS_FSTYPES}"
IMAGE_FSTYPES:pn-tegra-initrd-flash-initramfs:tegra = "${TEGRA_INITRD_FLASH_INITRAMFS_FSTYPES}"

# 64GB eMMC capacity in bytes (P3701-0005). Upstream agx-orin.inc:7 defaults to
# 31276924928 (32GB module value) and p3737-0000-p3701-0005.conf does not
# override it, so we must set it here. Value sourced from
# repos/meta-tegra/conf/machine/jetson-agx-orin-devkit-industrial.conf:9
# (P3701-0008, the Industrial 64GB SKU which uses the same eMMC class).
EMMC_SIZE = "63652757504"

# Stable board identity written to /etc/wendyos/device-type
WENDYOS_BOARD_ID = "jetson-agx-orin-emmc"
```

## conf/machine/jetson-agx-orin-devkit-nvme-wendyos.conf
```bitbake
# jetson-agx-orin-devkit-nvme-wendyos.conf
# NVMe boot configuration for Jetson AGX Orin DevKit (P3701-0005, 64GB RAM variant)

MACHINEOVERRIDES =. "jetson-agx-orin-devkit:"

# Inherit from upstream 64GB AGX Orin config (P3701-0005, SKU 0005)
# This sets TEGRA_BOARDSKU, KERNEL_DEVICETREE, BPMP DTB, PMIC, and SDRAM configs
# for the 64GB module variant
require conf/machine/p3737-0000-p3701-0005.conf

# Use NVIDIA prebuilt UEFI firmware for AGX Orin
# Source-built edk2-firmware-tegra causes a boot loop on this platform
PREFERRED_PROVIDER_virtual/bootloader = "tegra-uefi-prebuilt"

# AB upgrades & bootloader choices (board-specific)
UBOOT_EXTLINUX = "1"
USE_REDUNDANT_FLASH_LAYOUT_DEFAULT = "1"

MENDER_FEATURES_DISABLE:append = " mender-uboot"
MENDER_EFI_LOADER = ""

# UEFI Capsule Update Configuration
# Disable Secure Boot for development/testing (no signing keys configured)
# When "false": No key enrollment, Secure Boot disabled, unsigned capsules accepted
# Set to "true" for production after implementing proper signing infrastructure
TEGRA_UEFI_USE_SIGNED_FILES = "false"

# NVMe Storage geometry (board-specific)
# Set flash image size to 64GB (automatically sets MENDER_STORAGE_TOTAL_SIZE_MB = 51000)
WENDYOS_FLASH_IMAGE_SIZE = "64GB"
MENDER_STORAGE_DEVICE_BASE = "/dev/nvme0n1p"
MENDER_BOOT_PART = "${MENDER_STORAGE_DEVICE_BASE}11"
MENDER_ROOTFS_PART_A = "${MENDER_STORAGE_DEVICE_BASE}1"
MENDER_ROOTFS_PART_B = "${MENDER_STORAGE_DEVICE_BASE}2"

# IMPORTANT: Use partition 17 for Mender data, NOT partition 15 (UDA)
# UDA (p15) is reserved by NVIDIA and positioned before rootfs partitions,
# preventing expansion. Partition 17 (mender_data, renamed from permanet_user_storage)
# is positioned AFTER APP_b and can expand to fill remaining disk space.
# See docs/partition-layout-fix-plan.md for detailed analysis.
MENDER_DATA_PART_NUMBER = "17"
MENDER_DATA_PART = "${MENDER_STORAGE_DEVICE_BASE}${MENDER_DATA_PART_NUMBER}"

# Initial size - will auto-expand on first boot via mender-grow-data.service
MENDER_DATA_PART_SIZE_MB = "512"

# NVMe boot device configuration
TNSPEC_BOOTDEV = "nvme0n1p1"

# Use NVMe partition layout (same as Orin Nano - both use Tegra234)
PARTITION_LAYOUT_TEMPLATE_DEFAULT = "flash_t234_qspi.xml"
PARTITION_LAYOUT_TEMPLATE_DEFAULT_SUPPORTS_REDUNDANT = "1"
PARTITION_LAYOUT_EXTERNAL_DEFAULT = "flash_l4t_t234_nvme.xml"

# Jetson image formats that are machine/BSP oriented:
IMAGE_FSTYPES:tegra = "tegraflash mender dataimg"
IMAGE_FSTYPES:pn-tegra-minimal-initramfs:tegra = "${INITRAMFS_FSTYPES}"
IMAGE_FSTYPES:pn-tegra-initrd-flash-initramfs:tegra = "${TEGRA_INITRD_FLASH_INITRAMFS_FSTYPES}"

# If you really need it, board param (but consider removing if unused):
EMMC_SIZE = "0"
```

## conf/machine/jetson-agx-thor-devkit-nvme-wendyos.conf
```bitbake
#
# jetson-agx-thor-devkit-nvme-wendyos.conf
# NVMe boot configuration for NVIDIA Jetson AGX Thor Developer Kit
#
#@TYPE: Machine
#@NAME: Nvidia Jetson AGX Thor Developer Kit (NVMe Boot)
#@DESCRIPTION: Machine configuration for NVIDIA Jetson AGX Thor Developer Kit with NVMe boot
#
# Hardware: P3834-0008 module + P4071-0000 carrier board
# SoC: Tegra264 (T264) - 14-core ARMv9-A Neoverse-V3AE
# Storage: NVMe only (no internal eMMC)
# L4T: R38.2.x (JetPack 7.0)
# Yocto: 5.3 (whinlatter)
#

MACHINEOVERRIDES =. "jetson-agx-thor-devkit:"

# Require upstream base configuration
require conf/machine/jetson-agx-thor-devkit.conf

# Use prebuilt bootloader components to avoid complex build dependencies (meta-clang, etc)
PREFERRED_PROVIDER_hafnium = "hafnium-prebuilt"
PREFERRED_VERSION_hafnium = "38.2.1%"
PREFERRED_PROVIDER_edk2-nvidia-standalone-mm = "edk2-nvidia-standalone-mm-prebuilt"
USE_PREBUILT_OPTEE = "1"

# AB upgrades & bootloader
UBOOT_EXTLINUX = "1"
USE_REDUNDANT_FLASH_LAYOUT_DEFAULT = "1"

# UEFI boot (disable U-Boot)
MENDER_FEATURES_DISABLE:append = " mender-uboot"
MENDER_EFI_LOADER = ""

# UEFI Configuration
# Disable Secure Boot for development/testing (no signing keys configured)
# When "false": No key enrollment, Secure Boot disabled, unsigned capsules accepted
# Set to "true" for production after implementing proper signing infrastructure
TEGRA_UEFI_USE_SIGNED_FILES = "false"

# UEFI Capsule Update Support
# Controlled by WENDYOS_UPDATE_BOOTLOADER variable (default: disabled)
# When enabled, bootloader updates are delivered via UEFI capsule mechanism
TEGRA_UEFI_CAPSULE_UPDATE_ENABLE ?= "${@'true' if d.getVar('WENDYOS_UPDATE_BOOTLOADER') == '1' else 'false'}"

# NVMe Storage Configuration
# Thor only supports NVMe boot (no internal eMMC)
WENDYOS_FLASH_IMAGE_SIZE ??= "64GB"
MENDER_STORAGE_DEVICE_BASE = "/dev/nvme0n1p"
MENDER_BOOT_PART = "${MENDER_STORAGE_DEVICE_BASE}11"
MENDER_ROOTFS_PART_A = "${MENDER_STORAGE_DEVICE_BASE}1"
MENDER_ROOTFS_PART_B = "${MENDER_STORAGE_DEVICE_BASE}2"

# IMPORTANT: Use partition 17 for Mender data
# Partition 17 (mender_data, renamed from permanent_user_storage) is positioned
# AFTER APP_b and can expand to fill remaining disk space.
MENDER_DATA_PART_NUMBER = "17"
MENDER_DATA_PART = "${MENDER_STORAGE_DEVICE_BASE}${MENDER_DATA_PART_NUMBER}"

# Initial data partition size - will auto-expand on first boot via mender-grow-data.service
MENDER_DATA_PART_SIZE_MB = "512"

# Boot device
TNSPEC_BOOTDEV = "nvme0n1p1"

# T264 Partition Layout Templates
# Thor uses T264-specific partition layouts with QSPI + NVMe
PARTITION_LAYOUT_TEMPLATE_DEFAULT = "flash_l4t_t264_qspi.xml"
PARTITION_LAYOUT_TEMPLATE_DEFAULT_SUPPORTS_REDUNDANT = "1"
PARTITION_LAYOUT_EXTERNAL_DEFAULT = "flash_l4t_t264_nvme.xml"

# Image formats - moved to individual recipes to avoid global application
# IMAGE_FSTYPES set per-recipe to prevent non-Tegra images from inheriting tegraflash
# IMAGE_FSTYPES:tegra = "tegraflash mender dataimg"
IMAGE_FSTYPES:pn-tegra-minimal-initramfs:tegra = "${INITRAMFS_FSTYPES}"
IMAGE_FSTYPES:pn-tegra-initrd-flash-initramfs:tegra = "${TEGRA_INITRD_FLASH_INITRAMFS_FSTYPES}"

# Thor has no eMMC
EMMC_SIZE = "0"

# Boot control overlay for A/B boot priority management
# This device-tree overlay ensures UEFI bootloader respects Mender's A/B slot selection
# Note: Just the filename - image_types_tegra.bbclass will look for it in DEPLOY_DIR_IMAGE
TEGRA_BOOTCONTROL_OVERLAYS = "boot-priority.dtbo"

# Device Tree Blob location for tegraflash packaging
# DTB is staged to /usr/share/tegraflash (which gets staged to sysroot), not /boot/devicetree
# Override EXTERNAL_KERNEL_DEVICETREE to point to the staged location
EXTERNAL_KERNEL_DEVICETREE = "${RECIPE_SYSROOT}/usr/share/tegraflash"

# Plugin Manager overlays - skip dynamic overlay as it's not available yet
# TODO: Investigate if this overlay is needed for full hardware functionality
TEGRA_PLUGIN_MANAGER_OVERLAYS = ""
```

## conf/machine/jetson-orin-nano-devkit-nvme-wendyos.conf
```bitbake
# jetson-orin-nano-devkit-nvme-wendyos.conf
# NVMe boot configuration for Jetson Orin Nano DevKit

MACHINEOVERRIDES =. "jetson-orin-nano-devkit:"

# include upstream base if available
require conf/machine/jetson-orin-nano-devkit-nvme.conf

# AB upgrades & bootloader choices (board-specific)
UBOOT_EXTLINUX = "1"
USE_REDUNDANT_FLASH_LAYOUT_DEFAULT = "1"

MENDER_FEATURES_DISABLE:append = " mender-uboot"
MENDER_EFI_LOADER = ""

# UEFI Capsule Update Configuration
# Disable Secure Boot for development/testing (no signing keys configured)
# When "false": No key enrollment, Secure Boot disabled, unsigned capsules accepted
# Set to "true" for production after implementing proper signing infrastructure
TEGRA_UEFI_USE_SIGNED_FILES = "false"

# NVMe Storage geometry (board-specific)
# Set flash image size to 64GB (automatically sets MENDER_STORAGE_TOTAL_SIZE_MB = 51000)
WENDYOS_FLASH_IMAGE_SIZE = "64GB"
MENDER_STORAGE_DEVICE_BASE = "/dev/nvme0n1p"
MENDER_BOOT_PART = "${MENDER_STORAGE_DEVICE_BASE}11"
MENDER_ROOTFS_PART_A = "${MENDER_STORAGE_DEVICE_BASE}1"
MENDER_ROOTFS_PART_B = "${MENDER_STORAGE_DEVICE_BASE}2"

# IMPORTANT: Use partition 17 for Mender data, NOT partition 15 (UDA)
# UDA (p15) is reserved by NVIDIA and positioned before rootfs partitions,
# preventing expansion. Partition 17 (mender_data, renamed from permanet_user_storage)
# is positioned AFTER APP_b and can expand to fill remaining disk space.
# See docs/partition-layout-fix-plan.md for detailed analysis.
MENDER_DATA_PART_NUMBER = "17"
MENDER_DATA_PART = "${MENDER_STORAGE_DEVICE_BASE}${MENDER_DATA_PART_NUMBER}"

# Initial size - will auto-expand on first boot via mender-grow-data.service
MENDER_DATA_PART_SIZE_MB = "512"

# NVMe boot device configuration
TNSPEC_BOOTDEV = "nvme0n1p1"

# Use NVMe partition layout
PARTITION_LAYOUT_TEMPLATE_DEFAULT = "flash_t234_qspi.xml"
PARTITION_LAYOUT_TEMPLATE_DEFAULT_SUPPORTS_REDUNDANT = "1"
PARTITION_LAYOUT_EXTERNAL_DEFAULT = "flash_l4t_t234_nvme.xml"

# Image formats - moved to wendyos-image.bb to avoid global application
# IMAGE_FSTYPES:tegra = "tegraflash mender dataimg"
IMAGE_FSTYPES:pn-tegra-minimal-initramfs:tegra = "${INITRAMFS_FSTYPES}"
IMAGE_FSTYPES:pn-tegra-initrd-flash-initramfs:tegra = "${TEGRA_INITRD_FLASH_INITRAMFS_FSTYPES}"

# If you really need it, board param (but consider removing if unused):
EMMC_SIZE = "0"
```
