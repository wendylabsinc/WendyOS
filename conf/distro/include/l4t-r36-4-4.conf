## conf/distro/include/l4t-r36-4-4.conf
```bitbake
#
# L4T R36.4.4 Version Pinning Configuration
# This file pins all NVIDIA L4T packages to release 36.4.4 (JetPack 6.2.1)
#

# L4T version string (format: major.minor.patch)
L4T_VERSION = "36.4.4"

# Corresponding BSP version used by meta-tegra
L4T_BSP_VERSION = "r36.4.4"

# CUDA version for L4T 36.4
# JetPack 6.2.1 (L4T 36.4.4) includes CUDA 12.6
CUDA_VERSION = "12.6"
CUDA_VERSION_DASHED = "12-6"

# cuDNN version for this release
CUDNN_VERSION = "9.3.0"

# TensorRT version for this release
TENSORRT_VERSION = "10.3.0"

# Pin specific L4T packages to r36.4.4
# These PREFERRED_VERSION settings ensure Yocto uses the correct versions
PREFERRED_VERSION_tegra-libraries = "36.4.4%"
PREFERRED_VERSION_tegra-libraries-multimedia = "36.4.4%"
PREFERRED_VERSION_tegra-libraries-cuda = "36.4.4%"
PREFERRED_VERSION_tegra-libraries-nvsci = "36.4.4%"

# CUDA toolkit pinning
PREFERRED_VERSION_cuda-toolkit = "12.6%"
PREFERRED_VERSION_cuda-cudart = "12.6%"
PREFERRED_VERSION_cuda-nvcc = "12.6%"

# cuDNN pinning
PREFERRED_VERSION_cudnn = "9.3%"

# TensorRT pinning
PREFERRED_VERSION_tensorrt-core = "10.3%"
PREFERRED_VERSION_tensorrt-plugins = "10.3%"

# NVIDIA container runtime
PREFERRED_VERSION_libnvidia-container = "1.16%"
PREFERRED_VERSION_nvidia-container-toolkit = "1.16%"

# Optional: Force specific git SHAs if needed for reproducibility
# L4T_BSP_SHA256 = "your-sha-here"
# L4T_KERNEL_SHA256 = "your-sha-here"

# Prevent automatic updates
# This ensures builds are reproducible and don't fetch newer versions
TEGRA_SKIP_VERSION_CHECK = "1"
```

## conf/distro/include/l4t-r38-2-1.conf
```bitbake
#
# L4T R38.2.1 Version Pinning Configuration
# This file pins all NVIDIA L4T packages to release 38.2.1 (JetPack 7.0)
# For NVIDIA Jetson AGX Thor (Tegra264) support
# Note: nvidia-kernel-oot will use 38.2.2+git from its git recipe
#

# L4T version string (format: major.minor.patch)
L4T_VERSION = "38.2.1"

# Corresponding BSP version used by meta-tegra
L4T_BSP_VERSION = "r38.2.1"

# BSP architecture for Thor (T264)
L4T_BSP_ARCH = "t264"

# CUDA version for L4T 38.2
# JetPack 7.0 (L4T 38.2) includes CUDA 13.0
CUDA_VERSION = "13.0"
CUDA_VERSION_DASHED = "13-0"

# cuDNN version for this release
CUDNN_VERSION = "9.12.0"

# TensorRT version for this release
TENSORRT_VERSION = "10.13.3"

# Pin specific L4T packages to r38.2.1
# These PREFERRED_VERSION settings ensure Yocto uses the correct versions
PREFERRED_VERSION_tegra-libraries = "38.2.1%"
PREFERRED_VERSION_tegra-libraries-multimedia = "38.2.1%"
PREFERRED_VERSION_tegra-libraries-cuda = "38.2.1%"
PREFERRED_VERSION_tegra-libraries-nvsci = "38.2.1%"

# CUDA toolkit pinning
PREFERRED_VERSION_cuda-toolkit = "13.0%"
PREFERRED_VERSION_cuda-cudart = "13.0%"
PREFERRED_VERSION_cuda-nvcc = "13.0%"

# cuDNN pinning
PREFERRED_VERSION_cudnn = "9.12%"

# TensorRT pinning
PREFERRED_VERSION_tensorrt-core = "10.13%"
PREFERRED_VERSION_tensorrt-plugins = "10.13%"

# NVIDIA container runtime
PREFERRED_VERSION_libnvidia-container = "1.16%"
PREFERRED_VERSION_nvidia-container-toolkit = "1.16%"

# Kernel version for L4T R38.2 (Noble/Ubuntu 24.04 base)
PREFERRED_VERSION_linux-noble-nvidia-tegra = "6.8%"

# Optional: Force specific git SHAs if needed for reproducibility
# L4T_BSP_SHA256 = "your-sha-here"
# L4T_KERNEL_SHA256 = "your-sha-here"

# Prevent automatic updates
# This ensures builds are reproducible and don't fetch newer versions
TEGRA_SKIP_VERSION_CHECK = "1"
```

## conf/distro/include/l4t-r38-4-0.conf
```bitbake
#
# L4T R38.4.0 Version Configuration
# For NVIDIA Jetson AGX Thor (Tegra264) support
#
# Note: meta-tegra wip-l4t-r38.4.0 branch has exactly one version of each
# recipe, so PREFERRED_VERSION pins are not needed. L4T_VERSION is set by
# meta-tegra's l4t_version.bbclass (38.4.0).
#

# CUDA/cuDNN/TensorRT versions for reference (used in packagegroup comments)
CUDA_VERSION = "13.0"
CUDA_VERSION_DASHED = "13-0"
CUDNN_VERSION = "9.12.0"
TENSORRT_VERSION = "10.13.3"
```

## conf/distro/include/mender.inc
```bitbake
# Image outputs: disk + OTA artifact
# IMAGE_FSTYPES += "uefiimg mender ext4"

INHERIT += "mender-full"

# Enable automatic data partition growth on first boot
# This allows the data partition to expand to use all available disk space
MENDER_FEATURES_ENABLE:append = " mender-growfs-data"

# tegra
# these two classes only work as intended when being inherited in the
# OE4t setup-env.sh style environment, as they modify bblayers.conf
# and expect additional information on the host.
INHERIT:remove = "tegra-support-sanity distro_layer_buildinfo"
INHERIT += "tegra-mender-setup"
```

## conf/distro/include/qemu-distro.inc
```bitbake
# QEMU-specific distro configuration
# This file is included when building for QEMU machines

# Disable Tegra/hardware-specific features for QEMU
WENDYOS_UPDATE_BOOTLOADER = "0"
WENDYOS_EFI_DEBUG = "0"
WENDYOS_USB_GADGET = "0"
WENDYOS_DEEPSTREAM = "0"

# Disable persistent journal logs for QEMU (no /data partition)
# This prevents var-log.mount from being created
WENDYOS_PERSIST_JOURNAL_LOGS = "0"

# Note: Mender is not inherited for QEMU (see wendyos.conf)
# QEMU uses simple single-partition ext4 layout without Mender A/B partitions
```

## conf/distro/include/qemu-image.inc
```bitbake
# QEMU-specific image configuration
# This file is included when building for QEMU machines (MACHINEOVERRIDES contains 'qemuall')

# Disable Mender features for QEMU
# QEMU uses simple single-partition layout without Mender A/B partitions
# IMPORTANT: Must be unset (not empty string) to prevent mender-maybe-setup from inheriting mender-setup
unset MENDER_FEATURES_ENABLE
MENDER_CONNECT_ENABLE = "0"

# QEMU rootfs size configuration (in KB)
# Override in local.conf: QEMU_ROOTFS_SIZE = "1048576"  # 1GB
# Override in local.conf: QEMU_ROOTFS_SIZE = "2097152"  # 2GB
# Override in local.conf: QEMU_ROOTFS_SIZE = "4194304"  # 4GB
QEMU_ROOTFS_SIZE ??= "4194304"
IMAGE_ROOTFS_SIZE:qemuall = "${QEMU_ROOTFS_SIZE}"
IMAGE_ROOTFS_EXTRA_SPACE:qemuall = "0"

# Remove packages not needed for QEMU
# Note: mender-configure, mender-connect, and python3-pip-jetson-config are now
# conditionally added in wendyos-image.bb, so no need to remove them here
# USB gadget packages are conditionally added via WENDYOS_USB_GADGET variable
# Note: mender-esp is only in tegra-image.inc (mutually exclusive), no need to remove
IMAGE_INSTALL:remove = " \
    gadget-setup \
    usb-gadget-modules \
    usb-network-tuning \
    "

# Add QEMU-specific packages
# - udev-qemu-usb0: Rename virtio-net to usb0 for NetworkManager compatibility
IMAGE_INSTALL:append = " \
    udev-qemu-usb0 \
    "
```

## conf/distro/include/rpi-distro.inc
```bitbake
# RPi5-specific distro configuration
# This file is included when building for RPi machines

# No Mender for RPi5
MENDER_CONNECT_ENABLE = "0"
# No EFI/UEFI on RPi5
WENDYOS_UPDATE_BOOTLOADER = "0"
WENDYOS_EFI_DEBUG = "0"
WENDYOS_DEEPSTREAM = "0"
WENDYOS_PERSIST_JOURNAL_LOGS ?= "0"
# WiFi support
DISTRO_FEATURES:append = " wifi"
# WKS search path
WKS_SEARCH_PATH:prepend = "${TD_DISTRO_LAYERDIR}/wic:"

# PARTUUID defaults (overwritten at parse-time by partuuid.bbclass)
WENDYOS_BOOT_PARTUUID ?= "00000000-0000-0000-0000-000000000000"
WENDYOS_ROOT_PARTUUID ?= "00000000-0000-0000-0000-000000000000"
```

## conf/distro/include/rpi-image.inc
```bitbake
# RPi5-specific image configuration
# This file is included when building for RPi machines (MACHINEOVERRIDES contains 'rpi')

inherit partuuid-rpi

# RPi5 has no Mender; suppress the unconditional MENDER_CONNECT_ENABLE=1 set by wendyos-image.bb
MENDER_CONNECT_ENABLE = "0"

# RPi5-specific packages
IMAGE_INSTALL:append = " \
    packagegroup-wendyos-rpi \
    "

# Container runtime
IMAGE_INSTALL:append = " \
    ${@oe.utils.ifelse(d.getVar('WENDYOS_CONTAINER_RUNTIME') == '1', ' packagegroup-wendyos-container', '')} \
    "

# wendyos-image.bb appends ext4 unconditionally; RPi5 only needs wic
IMAGE_FSTYPES:remove = "ext4"

# Remove Tegra-only packages added by tegra-image.inc or wendyos-image.bb.
# Layer separation removes these recipes from the parse tree, but IMAGE_INSTALL
# is resolved at task-scheduling time — absent packages must be explicitly removed.
IMAGE_INSTALL:remove = " \
    mender-esp \
    tegra-bootcontrol-overlay \
    packagegroup-wendyos-tegra \
    packagegroup-nvidia-container \
    nvidia-container-config \
    setup-nv-boot-control \
    usb-gadget-modules \
    usb-network-tuning \
    e2fsprogs-mke2fs \
    util-linux-mount \
    "

# WIC build dependencies
do_image_wic[depends] += " \
    rpi-cmdline:do_deploy \
    wic-tools:do_populate_sysroot \
    e2fsprogs-native:do_populate_sysroot \
    gptfdisk-native:do_populate_sysroot \
"
do_image_wic[depends] += "${PN}:do_generate_partuuids"
WIC_CREATE_EXTRA_ARGS ?= "--no-fstab-update"
```

## conf/distro/include/rpi-nvme-image.inc
```bitbake
# NVMe-specific image configuration for RPi5
# This file is included when building for the raspberrypi5-nvme machine
# (MACHINEOVERRIDES contains 'raspberrypi5-nvme')

IMAGE_INSTALL:append = " rpi-eeprom-nvme-config"
```

## conf/distro/include/tegra-image.inc
```bitbake
# Tegra/Jetson-specific image configuration
# This file is included when building for Tegra machines (MACHINEOVERRIDES contains 'tegra')

# Apply our UEFI boot-priority overlay during flash
TEGRA_BOOTCONTROL_OVERLAYS += "boot-priority.dtbo"

# Tegra-specific packages (Jetson hardware only)
# packagegroup-wendyos-tegra pulls in tegra-bootcontrol-overlay,
# setup-nv-boot-control, packagegroup-nvidia-container, and
# conditionally tegra-uefi-capsules/bootloader-update.
IMAGE_INSTALL:append = " \
    mender-esp \
    packagegroup-wendyos-tegra \
    "

# Enable DeepStream SDK support (optional - adds ~1GB to image)
# Tegra/NVIDIA hardware only - DeepStream requires NVIDIA GPUs
# Also enables l4t-deepstream.csv which provides:
# - GPU device nodes (/dev/nvhost-*) for tegrastats and GPU monitoring
# - CUDA compilation toolchain (headers, binaries, nvvm) for Triton/JIT
# - Additional libraries (libnuma) and monitoring paths
WENDYOS_USB_GADGET ?= "1"
WENDYOS_DEEPSTREAM ?= "1"
IMAGE_INSTALL:append = " \
    ${@oe.utils.ifelse( \
        d.getVar('WENDYOS_DEEPSTREAM') == '1', \
            ' \
                deepstream-7.1 \
            ', \
            '' \
        )} \
    "
```

## conf/distro/wendyos.conf
```bitbake
# (Optionally) pull in a private secrets file if present
# include conf/distro/include/mender-secrets.inc

# Mender configuration (only used when building for real hardware)
PREFERRED_PROVIDER_mender = "mender"
PREFERRED_VERSION_mender = "5.0.%"
# PREFERRED_VERSION_mender = "5.%"
MENDER_SERVER_URL = "https://docker.mender.io"

require conf/distro/poky.conf
require systemd.conf

# Conditionally require Mender and Tegra configuration for real hardware
# QEMU builds don't need Mender OTA or Tegra-specific setup
require ${@'' if ('qemuall' in d.getVar('MACHINEOVERRIDES').split(':') or 'rpi' in d.getVar('MACHINEOVERRIDES').split(':')) else 'conf/distro/include/mender.inc'}
require ${@'' if ('qemuall' in d.getVar('MACHINEOVERRIDES').split(':') or 'rpi' in d.getVar('MACHINEOVERRIDES').split(':')) else 'conf/distro/include/flash-image-sizes.inc'}

# Conditionally require L4T configuration only for Tegra machines
require ${@'conf/distro/include/l4t-r36-4-4.conf' if 'tegra' in d.getVar('MACHINEOVERRIDES').split(':') else ''}

# Network management with NetworkManager
DISTRO_FEATURES:append = " networkmanager"
VIRTUAL-RUNTIME_net_manager = "networkmanager"

# Optional: Use systemd-resolved for DNS (alternative to dnsmasq)
# DISTRO_FEATURES:append = " resolved"

# Note: MENDER_FEATURES_ENABLE is set in mender.inc (only included for Tegra/real hardware)
# QEMU doesn't use Mender, so this variable remains unset for QEMU builds

DISTRO = "wendyos"
DISTROOVERRIDES = "poky"

DISTRO_NAME = "WendyOS Linux platform"
DISTRO_VERSION = "0.12.0"
DISTRO_CODENAME = "scarthgap"

SDK_VENDOR = "-wendyossdk"
SDK_VERSION = "${@d.getVar('DISTRO_VERSION')}"
SDK_NAME = "${DISTRO}-${TCLIBC}-${SDKMACHINE}-${IMAGE_BASENAME}-${TUNE_PKGARCH}-${MACHINE}"
SDKPATHINSTALL = "/opt/${DISTRO}/${SDK_VERSION}"

# MAINTAINER = "name <email>"

# remove distro unnecessary feature(s)
DISTRO_FEATURES:remove = " \
    x11 \
    wayland \
    sysvinit \
    ptest \
    3g \
    "

# Add OpenGL support for TensorRT
DISTRO_FEATURES:append = " opengl"

# Add virtualization support for NVIDIA Container Toolkit
DISTRO_FEATURES:append = " virtualization"

# Add polkit for rtkit support (real-time audio priority)
DISTRO_FEATURES:append = " polkit"

# WendyOS Configuration Variables
# These can be overridden in local.conf or on the command line
WENDYOS_UPDATE_BOOTLOADER ?= "1"

# USB gadget network mode for the usb0 interface
# "link-local"  - RFC 3927 self-assigned 169.254.x.x (discovery via mDNS/Avahi)
# "dhcp-client" - Device is DHCP client (host must run DHCP server)
# "dhcp-server" - Device runs DHCP server via NM shared mode (requires dnsmasq)
WENDYOS_USB_NET_MODE ?= "link-local"

# Interfaces on which Avahi publishes mDNS services
# Default: usb0 only (device discoverable only by the directly-connected host)
# Set to "" to allow all interfaces (discoverable on LAN)
WENDYOS_MDNS_INTERFACES ?= "usb0"

# Enable UEFI/EFI debug build for verbose boot/capsule debug output
# Set to "1" to enable DEBUG mode (verbose UART output)
# Set to "0" for RELEASE mode (minimal output, production default)
WENDYOS_EFI_DEBUG ?= "0"

# Enable persistent journal logs on /data partition (for real hardware)
# Set to "1" for persistent logs (default for real hardware with /data)
# Set to "0" for volatile logs in tmpfs (QEMU overrides this to "0")
WENDYOS_PERSIST_JOURNAL_LOGS ?= "1"

# Config partition (FAT32, mountable on Linux/macOS/Windows)
# Used by Jetson XML layouts and RPi5 WKS files
WENDYOS_CONFIG_PART_SIZE_MB ?= "64"
WENDYOS_CONFIG_PART_NUMBER ?= "16"

# Include hardware-specific distro configuration
require ${@'conf/distro/include/qemu-distro.inc' if 'qemuall' in d.getVar('MACHINEOVERRIDES').split(':') else ''}
require ${@'conf/distro/include/rpi-distro.inc'  if 'rpi'     in d.getVar('MACHINEOVERRIDES').split(':') else ''}

# Set the '/var/log' location, i.e. either on persistent storage
# of on volatile filesystem
#
# [Note]
# On newer Yocto versions, the 'VOLATILE_LOG_DIR' becomes deprecated
# and the replacement is via the 'FILESYSTEM_PERMS_TABLES' variable.
VOLATILE_LOG_DIR = "${@'no' if d.getVar('WENDYOS_PERSIST_JOURNAL_LOGS') == '1' else 'yes'}"

PACKAGE_CLASSES ?= "package_rpm"
# PACKAGE_CLASSES = "package_ipk"

SANITY_TESTED_DISTROS ?= " \
    ubuntu-20.04 \n\
    ubuntu-22.04 \n\
    ubuntu-24.04 \n\
    "

# require conf/distro/include/poky-world-exclude.inc
# require conf/distro/include/no-static-libs.inc
# require conf/distro/include/yocto-uninative.inc
# require conf/distro/include/security_flags.inc

USE_REDUNDANT_FLASH_LAYOUT_DEFAULT ?= "1"

# INHERIT += "tegra-support-sanity"
# ESDK_CLASS_INHERIT_DISABLE:append = " tegra-support-sanity"

BB_SIGNATURE_HANDLER ?= "OEEquivHash"
BB_HASHSERVE ??= "auto"

# Enable creation of SPDX manifests by default
INHERIT += "create-spdx"

INHERIT += " \
    uninative \
    "

# Note: mender-setup is conditionally inherited via mender-maybe-setup class
# (from meta-mender layer.conf) based on MENDER_FEATURES_ENABLE being set.
# For QEMU: MENDER_FEATURES_ENABLE is unset in qemu-image.inc
# For Tegra: MENDER_FEATURES_ENABLE is set via mender-full class in mender.inc
```
